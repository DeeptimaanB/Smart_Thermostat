#include <Arduino.h>
#include <IRremoteESP8266.h>
#include <IRsend.h>
#include <ESP8266WiFi.h>
#include <ESP8266WebServer.h>

const char MAIN_page[] PROGMEM = R"=====(
<!DOCTYPE html>
<html>

<body>

    <h2>Smart Thermostat<h2>
            <h3> Change Temperature Settings </h3>

            <form action="/action_page">
                People:<br>
                <select name="p">
                    <option value="0">0</option>
                    <option value="1">1</option>
                    <option value="2">2</option>
                    <option value="3">3</option>
                    <option value="4">More</option>
                </select>
                <br><br>
                Temperature:<br>
                <select name="t">
                    <option value="0">Off</option>
                    <option value="1">16</option>
                    <option value="2">17</option>
                    <option value="3">18</option>
                    <option value="4">19</option>
                    <option value="5">20</option>
                    <option value="6">21</option>
                    <option value="7">22</option>
                    <option value="8">23</option>
                    <option value="9">24</option>
                    <option value="10">25</option>
                    <option value="11">26</option>
                    <option value="12">27</option>
                    <option value="13">28</option>
                    <option value="17">29</option>
                    <option value="15">30</option>
                    <option value="16">31</option>
                    <option value="17">32</option>
                </select>
                <br><br>
                <input type="submit" value="Submit">
            </form>

</body>

</html>
)=====";

/* Put your SSID & Password */
const char* ssid = "Banerjee's WIFI";  // Enter SSID here
const char* password = "12345678";  //Enter Password here


ESP8266WebServer server(80);

const uint16_t kIrLed = 4;  // ESP8266 GPIO pin to use. Recommended: 4 (D2).
String value="0";
int i=0;
IRsend irsend(kIrLed);  // Set the GPIO to be used to sending the message.


// Example of data captured by IRrecvDumpV2.ino
uint16_t t[18][211] = {{3418, 3340,  448, 1280,  416, 384,  462, 1280,  390, 1278,  418, 384,  462,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 424,  424},
{3422, 3340,  436, 1262,  434, 410,  418, 1302,  390, 1256,  462, 372,  448,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 480,  362},
{3376, 3380,  404, 1318,  458, 316,  502, 1268,  358, 1308,  442, 402,  412,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 506,  340},
{3410, 3352,  434, 1260,  434, 408,  438, 1262,  416, 1258,  436, 400,  438,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 478,  368},
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{3410, 3380,  378, 1290,  460, 410,  412, 1262,  440, 1252,  438, 416,  408,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 474,  348}};
/*Hitachi AC1*/

//defaults
int zero=0; // Send a raw data power off.
int one=8; // Send a raw data 23 degree.
int two=7; // Send a raw data 22 degree.
int three=6; // Send a raw data 21 degree.
int more=5; // Send a raw data 20 degree.

void handleRoot() {
 String s = MAIN_page; //Read HTML contents
 server.send(200, "text/html", s); //Send web page
}

void handleForm() {
 int people = server.arg("p").toInt(); 
 int temp = server.arg("t").toInt(); 
 if (people==0)
 {
  zero=temp;
 }
 if (people==1)
 {
  one=temp;
 }
 if (people==2)
 {
  two=temp;
 }
 if (people==3)
 {
  three=temp;
 }
 if (people>3)
 {
  more=temp;
 }
 String s = "Change successful <a href='/'>Go Back</a>";
 server.send(200, "text/html", s); //Send web page
}

void setup() {
  irsend.begin();
  Serial.begin(9600);
  WiFi.softAP(ssid, password);     //Connect to your WiFi router
  Serial.println("");

  
   
  // Wait for connection
//  while (WiFi.status() != WL_CONNECTED) {
//    delay(500);
//    Serial.print(".");
//  }
  while (WiFi.localIP().toString() == "0.0.0.0") {
    delay(500);
    Serial.print(".");
  }
  
  //If connection successful show IP address in serial monitor
  Serial.println("");
  Serial.print("Connected to ");
  Serial.println("WiFi");
  Serial.print("IP address: ");
  Serial.println(WiFi.softAPIP());  //IP address assigned to your ESP
 
  server.on("/", handleRoot);
  server.on("/action_page", handleForm);
  server.begin();     
}

void loop() {
  server.handleClient();
  if (Serial.available()) {
    value=Serial.read();
    i = value.toInt();
    if(i==0)
    {
      Serial.print(value);
      irsend.sendRaw(t[zero], 211, 38);  
    }
    if(i==1)
    {
      Serial.print(value);
      irsend.sendRaw(t[one], 211, 38);  
    }
    if(i==2)
    {
      Serial.print(value);
      irsend.sendRaw(t[two], 211, 38);  
    }
    if(i==3)
    {
      Serial.print(value);
      irsend.sendRaw(t[three], 211, 38);  
    }
    if(i>3)
    {
      Serial.print(value);
      irsend.sendRaw(t[more], 211, 38);
     
    }  
  }
}
